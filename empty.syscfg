//@cliArgs --device "MSPM0L130X" --package "VQFN-32(RHB)" --part "Default"
//@v2CliArgs --device "MSPM0L1306" --package "VQFN-32(RHB)"
// @cliArgs --board /ti/boards/LP_MSPM0L1306 --rtos nortos

/* Import the modules used in this configuration.*/
const GPIO   = scripting.addModule("/ti/driverlib/GPIO", {}, false);
const GPIO1  = GPIO.addInstance();
/*Write custom configuration values to the imported modules.*/
GPIO1.$name                         = "GPIO_LEDS";
GPIO1.port                          = "PORTA";
GPIO1.associatedPins.create(6); // Alterado de 4 para 5

GPIO1.associatedPins[0].$name       = "USER_LED_1";
GPIO1.associatedPins[0].assignedPin = "11";

GPIO1.associatedPins[1].$name       = "USER_LED_2";
GPIO1.associatedPins[1].assignedPin = "12";

GPIO1.associatedPins[2].$name       = "USER_LED_3";
GPIO1.associatedPins[2].assignedPin = "25";

GPIO1.associatedPins[3].$name        = "USER_TEST";
GPIO1.associatedPins[3].pin.$assign  = "PA1";

GPIO1.associatedPins[4].$name           = "USER_INPUT";
GPIO1.associatedPins[4].assignedPin      = "14";
GPIO1.associatedPins[4].direction        = "INPUT";

GPIO1.associatedPins[5].$name           = "USER_INPUT1";
GPIO1.associatedPins[5].assignedPin      = "13";
GPIO1.associatedPins[5].direction        = "INPUT";

const Board = scripting.addModule("/ti/driverlib/Board", {}, false);
const SYSCTL = scripting.addModule("/ti/driverlib/SYSCTL");
